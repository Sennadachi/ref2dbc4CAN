VERSION ""
NS_ :

BS_:

BU_: VBOX

BO_ 129 Steering_Angle: 8 VBOX
 SG_ Steering_Angle : 32|16@1- (1,0) [-720|720] "°" VBOX

BO_ 513 Engine_Speed: 8 VBOX
 SG_ Engine_Speed : 48|16@1+ (0.25,0) [0|8000] "rpm" VBOX

BO_ 512 Accelerator_Pedal_Position: 8 VBOX
 SG_ Accelerator_Pedal_Position : 0|8@1+ (0.5,0) [0|100] "%" VBOX

BO_ 133 Brake_Position: 8 VBOX
 SG_ Brake_Position : 48|16@1+ (0.15015,-15) [0|100] "%" VBOX

BO_ 513 Indicated_Vehicle_Speed_kph: 8 VBOX
 SG_ Indicated_Vehicle_Speed_kph : 16|16@1+ (0.01,-100) [-100|555.33] "km/h" VBOX

BO_ 1056 Coolant_Temperature: 8 VBOX
 SG_ Coolant_Temperature : 56|8@1+ (1,-40) [-40|213] "°C" VBOX

BO_ 1200 Wheel_Speed_FL_kph: 8 VBOX
 SG_ Wheel_Speed_FL_kph : 48|16@1+ (0.01,-100) [0|300] "km/h" VBOX

BO_ 1200 Wheel_Speed_FR_kph: 8 VBOX
 SG_ Wheel_Speed_FR_kph : 32|16@1+ (0.01,-100) [0|300] "km/h" VBOX

BO_ 1200 Wheel_Speed_RL_kph: 8 VBOX
 SG_ Wheel_Speed_RL_kph : 16|16@1+ (0.01,-100) [0|300] "km/h" VBOX

BO_ 1200 Wheel_Speed_RR_kph: 8 VBOX
 SG_ Wheel_Speed_RR_kph : 0|16@1+ (0.01,-100) [0|300] "km/h" VBOX

BO_ 513 Indicated_Vehicle_Speed_mph: 8 VBOX
 SG_ Indicated_Vehicle_Speed_mph : 16|16@1+ (0.00621,-100) [-62.1|344.85993] "mph" VBOX

BO_ 1200 Wheel_Speed_FL_mph: 8 VBOX
 SG_ Wheel_Speed_FL_mph : 48|16@1+ (0.00621,-100) [0|186.3] "mph" VBOX

BO_ 1200 Wheel_Speed_FR_mph: 8 VBOX
 SG_ Wheel_Speed_FR_mph : 32|16@1+ (0.00621,-100) [0|186.3] "mph" VBOX

BO_ 1200 Wheel_Speed_RL_mph: 8 VBOX
 SG_ Wheel_Speed_RL_mph : 16|16@1+ (0.00621,-100) [0|186.3] "mph" VBOX

BO_ 1200 Wheel_Speed_RR_mph: 8 VBOX
 SG_ Wheel_Speed_RR_mph : 0|16@1+ (0.00621,-100) [0|186.3] "mph" VBOX
